## sdkconfig.defaults
```kconfig
# 基础配置
CONFIG_ESPTOOLPY_FLASHSIZE_4MB=y
CONFIG_PARTITION_TABLE_SINGLE_APP=y

# FreeRTOS配置
CONFIG_FREERTOS_UNICORE=n
CONFIG_FREERTOS_HZ=1000
CONFIG_FREERTOS_ASSERT_ON_UNTESTED_FUNCTION=y

# 日志配置
CONFIG_LOG_DEFAULT_LEVEL_INFO=y
CONFIG_LOG_MAXIMUM_LEVEL=3

# SPI配置
CONFIG_SPI_MASTER_ISR_IN_IRAM=y
CONFIG_SPI_SLAVE_ISR_IN_IRAM=y
CONFIG_SPI_MASTER_IN_IRAM=y

# 堆内存配置
CONFIG_HEAP_POISONING_DISABLED=y
CONFIG_HEAP_TRACING_OFF=y

# 主任务栈大小
CONFIG_MAIN_TASK_STACK_SIZE=16384

# 优化级别
CONFIG_COMPILER_OPTIMIZATION_PERF=y
```
